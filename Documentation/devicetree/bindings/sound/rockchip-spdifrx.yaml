## Documentation/devicetree/bindings/sound/rockchip-spdifrx.yaml
```yaml
# SPDX-License-Identifier: (GPL-2.0-only OR BSD-2-Clause)
%YAML 1.2
---
$id: http://devicetree.org/schemas/sound/rockchip-spdif.yaml#
$schema: http://devicetree.org/meta-schemas/core.yaml#

title: Rockchip SPDIF Receiver

description:
  The SPDIF receiver block allows the processor to
  receive digital audio via a coaxial cable or a fibre cable.

properties:
  compatible:
    oneOf:
      - const: rockchip,rk3308-spdifrx

  reg:
    maxItems: 1

  interrupts:
    maxItems: 1

  clocks:
    items:
      - description: clock for SPDIF bus
      - description: clock for SPDIF controller

  clock-names:
    items:
      - const: mclk
      - const: hclk

  dmas:
    maxItems: 1

  dma-names:
    const: rx

  resets:
    maxItems: 1

  reset-names:
    const: spdifrx-m

  power-domains:
    maxItems: 1

  "#sound-dai-cells":
    const: 0

required:
  - compatible
  - reg
  - interrupts
  - clocks
  - clock-names
  - dmas
  - dma-names
  - "#sound-dai-cells"

additionalProperties: false

examples:
  - |
    #include <dt-bindings/clock/rk3308-cru.h>
    #include <dt-bindings/interrupt-controller/arm-gic.h>
    spdif_rx: spdif-rx@ff3b0000 {
      #sound-dai-cells = <0>;
      compatible = "rockchip,rk3308-spdifrx";
      reg = <0x0 0xff3b0000 0x0 0x1000>;
      interrupts = <GIC_SPI 56 IRQ_TYPE_LEVEL_HIGH>;
      clocks = <&cru SCLK_SPDIF_RX>, <&cru HCLK_SPDIFRX>;
      clock-names = "mclk", "hclk";
      dmas = <&dmac1 14>;
      dma-names = "rx";
      resets = <&cru SRST_SPDIFRX_M>;
      reset-names = "spdifrx-m";
      status = "disabled";
    };
```

## sound/soc/generic/Kconfig
```kconfig
config SND_SIMPLE_CARD
	tristate "ASoC Simple sound card support"
	help
	  This option enables generic simple sound card support

config SND_COMPLEX_CARD
	tristate "ASoC Complex sound card support"
	help
	  This option enables generic simple sound card support
```
